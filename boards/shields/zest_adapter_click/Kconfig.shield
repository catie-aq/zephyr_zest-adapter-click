## boards/shields/zest_adapter_click/Kconfig.shield
```kconfig
# Copyright (c) 2024 CATIE
# SPDX-License-Identifier: Apache-2.0

config SHIELD_ZEST_ADAPTER_CLICK
	def_bool $(shields_list_contains,zest_adapter_click)
```
