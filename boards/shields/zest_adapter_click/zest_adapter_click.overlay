/*
 * Copyright (c) 2024, CATIE
 * SPDX-License-Identifier: Apache-2.0
 */

#include <zephyr/dt-bindings/gpio/sixtron-header.h>

#define PERIPHERAL_ZEST_ADAPTATER_CLICK(port) \
	mikrobus_serial: &sixtron_connector_##port##_uart {}; \
	mikrobus_i2c: &sixtron_connector_##port##_i2c {}; \
	mikrobus_spi: &sixtron_connector_##port##_spi {};

#define GPIO_NEXUS_ZEST_ADAPTATER_CLICK(port) \
	/ { \
		mikrobus_header: mikrobus-connector##port { \
			compatible = "mikro-bus"; \
			#gpio-cells = <2>; \
			gpio-map-mask = <0xffffffff 0xffffffc0>; \
			gpio-map-pass-thru = <0 0x3f>; \
			gpio-map =	<0 0 &sixtron_connector_##port ADC1 0>, \
					<2 0 &sixtron_connector_##port SPI_SS 0>, \
					<3 0 &sixtron_connector_##port SPI_SCK 0>, \
					<4 0 &sixtron_connector_##port SPI_MISO 0>, \
					<5 0 &sixtron_connector_##port SPI_MOSI 0>, \
					<6 0 &sixtron_connector_##port PWM1 0>, \
					<7 0 &sixtron_connector_##port DIO3 0>, \
					<8 0 &sixtron_connector_##port UART_RX 0>, \
					<9 0 &sixtron_connector_##port UART_TX 0>, \
					<10 0 &sixtron_connector_##port I2C_SCL 0>, \
					<11 0 &sixtron_connector_##port I2C_SDA 0>; \
		}; \
	};

#define ZEST_ADAPTATER_CLICK(port) \
	PERIPHERAL_ZEST_ADAPTATER_CLICK(port) \
	GPIO_NEXUS_ZEST_ADAPTATER_CLICK(port)
